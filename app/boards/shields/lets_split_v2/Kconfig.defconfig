## app/boards/shields/lets_split_v2/Kconfig.defconfig
```kconfig
if SHIELD_LETS_SPLIT_V2_LEFT

config ZMK_KEYBOARD_NAME
    default "Let's Split V2"

config ZMK_SPLIT_ROLE_CENTRAL
    default y

endif

if SHIELD_LETS_SPLIT_V2_LEFT || SHIELD_LETS_SPLIT_V2_RIGHT

config ZMK_SPLIT
    default y

endif
```
